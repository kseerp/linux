## Documentation/devicetree/bindings/iio/adc/adi,ltc2358.yaml
```yaml
# SPDX-License-Identifier: (GPL-2.0-only OR BSD-2-Clause)
# Copyright 2023 Analog Devices Inc.
%YAML 1.2
---
$id: http://devicetree.org/schemas/bindings/iio/adc/adi,ltc2358.yaml
$schema: http://devicetree.org/meta-schemas/core.yaml#

title: Linear Technology LTC2358 ADC device driver

maintainers:
  - Kim Seer Paller <kimseer.paller@analog.com>

description: |
  The LTC® 2358, Buffered Quad, 350ksps/Ch Differential
  ±10.24V ADC with 30VP-P Common Mode Range.

properties:
  compatible:
    enum:
      - adi,ltc2358

  reg:
    maxItems: 1
    type: integer

patternProperties:
  "^channel@([0-7])$":
    type: object
    description: Represents one input channel

    properties:
      reg:
        description: Represents the index of a channel
        type: integer
        minimum: 0
        maximum: 7

    required:
      - reg
      - config-number

      properties:
        config-number:
          type: integer

required:
  - compatible

examples:
  - |
    ltc2358: ltc2358@0 {
        compatible = "adi,ltc2358";
        reg = <0>;
        spi-max-frequency = <1000000>;
        status = "okay";

        #address-cells = <1>;
        #size-cells = <0>;

        channel@0 {
            reg = <0>;
            config-number = <3>;
        };
    };
```

## Documentation/devicetree/bindings/iio/adc/adi,max14001.yaml
```yaml
# SPDX-License-Identifier: (GPL-2.0 OR BSD-2-Clause)
# Copyright 2023 Analog Devices Inc.
%YAML 1.2
---
$id: http://devicetree.org/schemas/iio/adc/adi,max14001.yaml#
$schema: http://devicetree.org/meta-schemas/core.yaml#

title: MAX14001 ADC device driver

maintainers:
  - Kim Seer Paller <kimseer.paller@analog.com>

description: |
    Single channel 10 bit ADC with SPI interface. Datasheet
    can be found here:
      https://www.analog.com/media/en/technical-documentation/data-sheets/MAX14001-MAX14002.pdf

properties:
  compatible:
    enum:
      - adi,max14001

  reg:
    maxItems: 1

  spi-max-frequency:
    maximum: 5000000

  vref-supply:
    description: Voltage reference to establish input scaling.

  use-fadc:
    type: boolean
    description: |
      If set to 1, the filtered ADC data (FADC register) will be read.
      If set to 0, the unfiltered ADC data (ADC register) will be read.

  inrush-mode:
    type: boolean
    description: |
      0: ADC controlled
      1: FAST inrush mode

  filter:
    type: integer
    description: |
      0: Filtering off
      1: Average 2 readings
      2: Average 4 readings
      3: Average 8 readings

  current-source:
    type: boolean
    description: |
      Connects the 70uA current source to the REFIN pin.
      0: current souce off
      1: Current source on

required:
  - compatible
  - reg
  - spi-max-frequency
  - adi,use-fadc
  - adi,inrush-mode
  - adi,filter
  - adi,current-source

allOf:
  - $ref: /schemas/spi-peripheral-props.yaml#

unevaluatedProperties: false

examples:
  - |
    spi {
        #address-cells = <1>;
        #size-cells = <0>;
        status = "okay";

        adc@0 {
            compatible = "adi,max14001";
            reg = <0>;
            spi-max-frequency = <5000000>;
            vref-supply = <&vref_reg>;
            use-fadc = <1>;
            inrush-mode = <1>;
            current-source = <0>;
            filter = <0>;
        };
    };
...
```
